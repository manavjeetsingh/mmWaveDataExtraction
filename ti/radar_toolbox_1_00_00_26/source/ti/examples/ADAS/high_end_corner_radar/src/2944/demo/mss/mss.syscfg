/**
 * @cliArgs --device "AWR294X" --package "ETS" --part "Default" --context "r5fss0-0" --product "MCU_PLUS_SDK_AWR2944@08.00.02"
 * @versions {"tool":"1.10.0+2123"}
 */

/**
 * Import the modules used in this configuration.
 */
const adcbuf     = scripting.addModule("/drivers/adcbuf/adcbuf", {}, false);
const adcbuf1    = adcbuf.addInstance();
const crc        = scripting.addModule("/drivers/crc/crc", {}, false);
const crc1       = crc.addInstance();
const ipc        = scripting.addModule("/drivers/ipc/ipc");
const uart       = scripting.addModule("/drivers/uart/uart", {}, false);
const uart2      = uart.addInstance();
const clock      = scripting.addModule("/kernel/dpl/clock");
const debug_log  = scripting.addModule("/kernel/dpl/debug_log");
const mpu_armv7  = scripting.addModule("/kernel/dpl/mpu_armv7", {}, false);
const mpu_armv71 = mpu_armv7.addInstance();
const mpu_armv72 = mpu_armv7.addInstance();
const mpu_armv73 = mpu_armv7.addInstance();
const mpu_armv74 = mpu_armv7.addInstance();
const mpu_armv75 = mpu_armv7.addInstance();
const mpu_armv76 = mpu_armv7.addInstance();
const mpu_armv77 = mpu_armv7.addInstance();

/**
 * Write custom configuration values to the imported modules.
 */
adcbuf1.$name = "CONFIG_ADCBUF0";

crc1.$name = "CONFIG_CRC0";

ipc.r5fss0_1     = "NONE";
ipc.vringNumBuf  = 1;
ipc.vringMsgSize = 1152;

uart2.$name           = "CONFIG_UART1";
uart2.baudRate        = 852272;
uart2.intrEnable      = "DISABLE";
uart2.UART.RX.$used   = false;
uart2.UART.TX.$assign = "ball.A14";

debug_log.enableCssLog            = false;
debug_log.enableLogZoneError      = false;
debug_log.enableLogZoneWarning    = false;
debug_log.enableUartLog           = true;
debug_log.uartLog.$name           = "CONFIG_UART0";
debug_log.uartLog.intrEnable      = "DISABLE";
debug_log.uartLog.UART.$assign    = "UARTA";
debug_log.uartLog.UART.RX.$assign = "ball.B16";
debug_log.uartLog.UART.TX.$assign = "ball.C16";

mpu_armv71.$name        = "CONFIG_MPU_REGION0";
mpu_armv71.attributes   = "Device";
mpu_armv71.allowExecute = false;

mpu_armv72.$name = "CONFIG_MPU_REGION1";
mpu_armv72.size  = 14;

mpu_armv73.$name    = "CONFIG_MPU_REGION2";
mpu_armv73.baseAddr = 0x80000;
mpu_armv73.size     = 14;

mpu_armv74.$name    = "CONFIG_MPU_REGION3";
mpu_armv74.baseAddr = 0x10200000;
mpu_armv74.size     = 20;

mpu_armv75.$name        = "CONFIG_MPU_REGION4";
mpu_armv75.baseAddr     = 0x102E0000;
mpu_armv75.size         = 16;
mpu_armv75.attributes   = "NonCached";
mpu_armv75.allowExecute = false;

mpu_armv76.$name        = "CONFIG_MPU_REGION5";
mpu_armv76.baseAddr     = 0xC5000000;
mpu_armv76.size         = 13;
mpu_armv76.attributes   = "NonCached";
mpu_armv76.allowExecute = false;

mpu_armv77.$name        = "CONFIG_MPU_REGION6";
mpu_armv77.baseAddr     = 0xA4030000;
mpu_armv77.size         = 12;
mpu_armv77.attributes   = "NonCached";
mpu_armv77.allowExecute = false;

/**
 * Pinmux solution for unlocked pins/peripherals. This ensures that minor changes to the automatic solver in a future
 * version of the tool will not impact the pinmux you originally saw.  These lines can be completely deleted in order to
 * re-solve from scratch.
 */
uart2.UART.$suggestSolution = "UARTB";
